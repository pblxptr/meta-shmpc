## meta-shmpc-bsp/conf/layer.conf
```bitbake
# We have a conf and classes directory, add to BBPATH
BBPATH .= ":${LAYERDIR}"

# We have recipes-* directories, add to BBFILES
BBFILES += "${LAYERDIR}/recipes-*/*/*.bb \
            ${LAYERDIR}/recipes-*/*/*.bbappend"

BBFILE_COLLECTIONS += "shmpc-bsp"
BBFILE_PATTERN_shmpc-bsp = "^${LAYERDIR}/"
BBFILE_PRIORITY_shmpc-bsp = "6"

LAYERDEPENDS_shmpc-bsp = "core"
LAYERDEPENDS_shmpc-bsp = "raspberrypi"
LAYERSERIES_COMPAT_shmpc-bsp = "hardknott"
```

## meta-shmpc-bsp/conf/machine/hhctrl.conf
```bitbake
#@TYPE: Machine
#@NAME: Henhouse Controller based on RPI Zero W
#@DESCRIPTION: Henhouse Controller

require conf/machine/raspberrypi0-wifi.conf

MACHINEOVERRIDES =. "raspberrypi0-wifi:"

MACHINE_FEATURES:remove = " screen touchscreen alsa"

### Kernel modules ###
MACHINE_ESSENTIAL_EXTRA_RRECOMMENDS:append = " kernel-module-hatch2sr"

### Without this, there is an additional check in runtime and write to inittab
SERIAL_CONSOLES_CHECK = ""

### HW PWM support on board ###
KERNEL_DEVICETREE:append = " overlays/pwm.dtbo"
KERNEL_DEVICETREE:append = " overlays/hatch2sr.dtbo"
KERNEL_DEVICETREE:append = " overlays/gpio-led.dtbo"

### RPI layer options
# Enable Uboot
RPI_USE_U_BOOT = "1"

# Enable uart
ENABLE_UART = "1"

# Config -> add options to /boot/config.txt

### -> Add motor control driver; PWM; configure pull ups
RPI_EXTRA_CONFIG:append = "gpio=23,24=pu\n"
RPI_EXTRA_CONFIG:append = "dtoverlay=pwm,pin=12,func=4\n"
RPI_EXTRA_CONFIG:append = "dtoverlay=hatch2sr\n"

### -> Add DS18B20 (temp sensor) driver
RPI_EXTRA_CONFIG:append = "dtoverlay=w1-gpio,pullup=1,gpiopin=4\n"

### -> Add leds driver
RPI_EXTRA_CONFIG:append = "dtoverlay=gpio-led,gpio=9,active_low,label=green\n"
RPI_EXTRA_CONFIG:append = "dtoverlay=gpio-led,gpio=10,active_low,label=red\n"
RPI_EXTRA_CONFIG:append = "dtoverlay=gpio-led,gpio=11,active_low,label=blue\n"
```

## meta-shmpc-bsp/wic/sdimage-hhctrl-image.wks
```
# short-description: Partitioned image for hhctrl machine
# long-description: Partitioned image for hhctrl machine

part /boot --source bootimg-partition --ondisk mmcblk0 --fstype=vfat --label boot --active --align 4096 --size 20
part / --source rootfs --ondisk mmcblk0 --fstype=ext4 --label root_a --align 4096
part / --source rootfs --ondisk mmcblk0 --fstype=ext4 --label root_b --align 4096
```

## meta-shmpc-os/conf/distro/cygnos-dev.conf
```bitbake
#
# An example of subclassing a distro, primarily used for testing alternate configuration
# combinations on the Yocto Project autobuilder
#

require conf/distro/include/common.conf

DISTRO = "cygnos-dev"
DISTRO_NAME = "CygnOS-dev"
DISTRO_VERSION = "1.0.0"
DISTRO_STAGE = "dev"
DISTROOVERRIDES = "poky:cygnos-dev"

DISTRO_FEATURES:append = " systemd"
VIRTUAL-RUNTIME_init_manager = "systemd"
DISTRO_FEATURES_BACKFILL_CONSIDERED = "sysvinit"
DISTRO_FEATURES_BACKFILL_CONSIDERED = "sysvinit"
```

## meta-shmpc-os/conf/distro/include/common.conf
```bitbake
require conf/distro/poky.conf

DISTRO_FEATURES = "largefile multiarch ext2 ipv4 ipv6 wifi"
DISTRO_FEATURES_BACKFILL_CONSIDERED = "pulseaudio"

TCLIBCAPPEND = ""

require conf/distro/include/poky-distro-alt-test-config.inc
```

## meta-shmpc-os/conf/layer.conf
```bitbake
# We have a conf and classes directory, add to BBPATH
BBPATH .= ":${LAYERDIR}"

# We have recipes-* directories, add to BBFILES
BBFILES += "${LAYERDIR}/recipes-*/*/*.bb \
            ${LAYERDIR}/recipes-*/*/*.bbappend"


BBFILE_COLLECTIONS += "meta-cygnos"

BBFILE_PATTERN_meta-cygnos = "^${LAYERDIR}/"
BBFILE_PRIORITY_meta-cygnos = "6"

LAYERDEPENDS_meta-cygnos = "core"
LAYERSERIES_COMPAT_meta-cygnos = "hardknott honister"
```

## meta-shmpc-swm/conf/layer.conf
```bitbake
# We have a conf and classes directory, add to BBPATH
BBPATH .= ":${LAYERDIR}"

# We have recipes-* directories, add to BBFILES
BBFILES += "${LAYERDIR}/recipes-*/*/*.bb \
            ${LAYERDIR}/recipes-*/*/*.bbappend"

BBFILE_COLLECTIONS += "shmpc-swm"
BBFILE_PATTERN_shmpc-swm = "^${LAYERDIR}/"
BBFILE_PRIORITY_shmpc-swm = "6"

LAYERDEPENDS_shmpc-swm = "core swupdate shmpc-bsp "
LAYERSERIES_COMPAT_shmpc-swm = "kirkstone"

IMAGE_FSTYPES += "ext4.gz"

# This adds /etc/build file with layers version description.
INHERIT += "image-buildinfo"

#TODO: Move this one to core image minimal update and remove?
# The goal is to have swupdate just after adding this layer to build, so let's add swupdate to image.
IMAGE_INSTALL:append = " swupdate"
```

## meta-shmpc-swm/wic/hhctrl-image-256M-swu.wks
```
part /boot --source bootimg-partition --ondisk mmcblk0 --fstype=vfat --label boot    --fixed-size 64M   --align 4096  --active
part /     --source rootfs            --ondisk mmcblk0 --fstype=ext4 --label root_1  --fixed-size 256M  --align 4096 
part       --source rootfs            --ondisk mmcblk0 --fstype=ext4 --label root_2  --fixed-size 256M  --align 4096
```
